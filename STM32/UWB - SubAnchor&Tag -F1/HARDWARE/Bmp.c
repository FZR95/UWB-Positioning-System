#include "OLED_SPI.h"
#include <stdio.h>
#include "Bmp.h"

//Signs
const unsigned char cbar[] = {
    0x00, 0x00, 0x00, 0x00, 0x00, 0x00, 0x00, 0x00, 0x00, 0x01, 0x01, 0x01, 0x01, 0x01, 0x01, 0x00};
const unsigned char colon[] = {
    0x00, 0x00, 0x00, 0xC0, 0xC0, 0x00, 0x00, 0x00, 0x00, 0x00, 0x00, 0x30, 0x30, 0x00, 0x00, 0x00};
const unsigned char comma[] = {
    0x00, 0x00, 0x00, 0x00, 0x00, 0x00, 0x00, 0x00, 0x00, 0x90, 0x70, 0x00, 0x00, 0x00, 0x00, 0x00};
const unsigned char dash[] = {
    0x00, 0x20, 0x1C, 0x03, 0x00, 0x00, 0x00, 0x00, 0x00, 0x00, 0x00, 0x80, 0x60, 0x1C, 0x03, 0x00};
const unsigned char symbol_dot[] = {
    0x00, 0x00, 0x00, 0x00, 0x00, 0x00, 0x00, 0x00, 0x00, 0x30, 0x30, 0x00, 0x00, 0x00, 0x00, 0x00};
const unsigned char percent[] = {
    0xF0, 0x08, 0xF0, 0x80, 0x60, 0x18, 0x00, 0x00, 0x00, 0x31, 0x0C, 0x03, 0x1E, 0x21, 0x1E, 0x00};
const unsigned char space[] = {
    0x00, 0x00, 0x00, 0x00, 0x00, 0x00, 0x00, 0x00, 0x00, 0x00, 0x00, 0x00, 0x00, 0x00, 0x00, 0x00};
const unsigned char underline[] = {
    0x00, 0x00, 0x00, 0x00, 0x00, 0x00, 0x00, 0x00, 0x00, 0x01, 0x01, 0x01, 0x01, 0x01, 0x01, 0x00};

const unsigned char Number[][16] = {
    {0x00, 0xE0, 0x10, 0x08, 0x08, 0x10, 0xE0, 0x00, 0x00, 0x0F, 0x10, 0x20, 0x20, 0x10, 0x0F, 0x00},
    {0x00, 0x00, 0x10, 0x10, 0xF8, 0x00, 0x00, 0x00, 0x00, 0x00, 0x20, 0x20, 0x3F, 0x20, 0x20, 0x00},
    {0x00, 0x70, 0x08, 0x08, 0x08, 0x08, 0xF0, 0x00, 0x00, 0x30, 0x28, 0x24, 0x22, 0x21, 0x30, 0x00},
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    {0x00, 0xF0, 0x08, 0x08, 0x08, 0x10, 0xE0, 0x00, 0x00, 0x01, 0x12, 0x22, 0x22, 0x11, 0x0F, 0x00}};
const unsigned char Alphabet[][16] = {
    //Capital
    {0x00, 0x00, 0xC0, 0x38, 0xE0, 0x00, 0x00, 0x00, 0x20, 0x3C, 0x23, 0x02, 0x02, 0x27, 0x38, 0x20},
    {0x08, 0xF8, 0x88, 0x88, 0x88, 0x70, 0x00, 0x00, 0x20, 0x3F, 0x20, 0x20, 0x20, 0x11, 0x0E, 0x00},
    {0xC0, 0x30, 0x08, 0x08, 0x08, 0x08, 0x38, 0x00, 0x07, 0x18, 0x20, 0x20, 0x20, 0x10, 0x08, 0x00},
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    {0x10, 0x08, 0x08, 0x08, 0xC8, 0x38, 0x08, 0x00, 0x20, 0x38, 0x26, 0x21, 0x20, 0x20, 0x18, 0x00},
    //Lowercase
    {0x00, 0x00, 0x80, 0x80, 0x80, 0x00, 0x00, 0x00, 0x00, 0x19, 0x24, 0x24, 0x12, 0x3F, 0x20, 0x00},
    {0x10, 0xF0, 0x00, 0x80, 0x80, 0x00, 0x00, 0x00, 0x00, 0x3F, 0x11, 0x20, 0x20, 0x11, 0x0E, 0x00},
    {0x00, 0x00, 0x00, 0x80, 0x80, 0x80, 0x00, 0x00, 0x00, 0x0E, 0x11, 0x20, 0x20, 0x20, 0x11, 0x00},
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    {0x00, 0x80, 0x80, 0x80, 0x80, 0x80, 0x80, 0x00, 0x00, 0x21, 0x30, 0x2C, 0x22, 0x21, 0x30, 0x00}};

const unsigned char Celsius[] = {
    0x06, 0x09, 0x09, 0xE6, 0xF8, 0x0C, 0x04, 0x02, 0x02, 0x02, 0x02, 0x02, 0x04, 0x1E, 0x00, 0x00,
    0x00, 0x00, 0x00, 0x07, 0x1F, 0x30, 0x20, 0x40, 0x40, 0x40, 0x40, 0x40, 0x20, 0x10, 0x00, 0x00};

const unsigned char Text_Wen1[] = {
    /*--  文字:  温  --*/
    /*--  Times New Roman12;  此字体下对应的点阵为：宽x高=16x16   --*/
    0x10, 0x60, 0x02, 0x8C, 0x00, 0x00, 0xFE, 0x92, 0x92, 0x92, 0x92, 0x92, 0xFE, 0x00, 0x00, 0x00,
    0x04, 0x04, 0x7E, 0x01, 0x40, 0x7E, 0x42, 0x42, 0x7E, 0x42, 0x7E, 0x42, 0x42, 0x7E, 0x40, 0x00};
const unsigned char Text_Du1[] = {
    /*--  文字:  度  --*/
    /*--  Times New Roman12;  此字体下对应的点阵为：宽x高=16x16   --*/
    0x00, 0x00, 0xFC, 0x24, 0x24, 0x24, 0xFC, 0x25, 0x26, 0x24, 0xFC, 0x24, 0x24, 0x24, 0x04, 0x00,
    0x40, 0x30, 0x8F, 0x80, 0x84, 0x4C, 0x55, 0x25, 0x25, 0x25, 0x55, 0x4C, 0x80, 0x80, 0x80, 0x00};
const unsigned char Text_Shi1[] = {
    /*--  文字:  湿  --*/
    /*--  Times New Roman12;  此字体下对应的点阵为：宽x高=16x16   --*/
    0x10, 0x60, 0x02, 0x8C, 0x00, 0xFE, 0x92, 0x92, 0x92, 0x92, 0x92, 0x92, 0xFE, 0x00, 0x00, 0x00,
    0x04, 0x04, 0x7E, 0x01, 0x44, 0x48, 0x50, 0x7F, 0x40, 0x40, 0x7F, 0x50, 0x48, 0x44, 0x40, 0x00};

void Display_Main(void)
{
    Display_String(0, 0, "Amplitude:", 10);
    Display_String(111, 2, "mV", 2);
    OLED_Draw_Chars(110, 4, Celsius, 16);
}

void Display_Info(int temp, int hum)
{
    unsigned int x = 0;
    unsigned int y = 0;
    y = 4;
    OLED_Draw_Chars(x, y, Text_Wen1, 16);
    x += 16;
    OLED_Draw_Chars(x, y, Text_Du1, 16);
    x += 16;
    OLED_Draw_Chars(x, y, colon, 8);
    x += 56;
    if (temp < 0)
    {
        OLED_Draw_Chars(x, y, cbar, 8);
        temp *= -1;
    }
    x += 8;
    OLED_Draw_Chars(x, y, judgenum(temp / 10), 8);
    x += 8;
    OLED_Draw_Chars(x, y, judgenum(temp % 10), 8);
    x += 8;
    OLED_Draw_Chars(x, y, Celsius, 16);

    x = 0;
    y += 2;
    OLED_Draw_Chars(x, y, Text_Shi1, 16);
    x += 16;
    OLED_Draw_Chars(x, y, Text_Du1, 16);
    x += 16;
    OLED_Draw_Chars(x, y, colon, 8);
    x += 56;
    x += 8;
    OLED_Draw_Chars(x, y, judgenum(hum / 10), 8);
    x += 8;
    OLED_Draw_Chars(x, y, judgenum(hum % 10), 8);
    x += 12;
    OLED_Draw_Chars(x, y, percent, 8);
}

void Display_Hex(unsigned char x, unsigned char y, unsigned int num)
{
    unsigned char hex[9];
    sprintf(hex, "%x", num);
    Display_String(x, y, hex,8);
}

void Display_Para(unsigned char x, unsigned char y, float para)
{
    unsigned int i;
    unsigned int Mpara, kpara, npara, mpara, upara;
    if (para < 0)
    {
        OLED_Draw_Chars(x, y, cbar, 8);
        para *= -1;
    }
    else
    {
        OLED_Draw_Chars(x, y, space, 8);
    }
    x += 8;
    Mpara = (para / 1000000);
    kpara = (para - (float)Mpara * 1000000) / 1000;
    npara = (para - (float)Mpara * 1000000 - (float)kpara * 1000);
    mpara = (para - (float)Mpara * 1000000 - (float)kpara * 1000 - (float)npara) * 1000;
    upara = (para - (float)Mpara * 1000000 - (float)kpara * 1000 - (float)npara) * 1000000 - (float)mpara * 1000;
    if (para == 0)
    {
        OLED_Draw_Chars(x, y, Number[0], 8);
    }
    if (para >= 1000000)
    {
        for (i = 1; i < 4; i++)
        {
            OLED_Draw_Chars(x + 24 - 8 * i, y, judgenum(Mpara), 8);
            Mpara /= 10;
        }
        OLED_Draw_Chars(x + 24, y, comma, 8);
        for (i = 1; i < 4; i++)
        {
            OLED_Draw_Chars(x + 56 - 8 * i, y, judgenum(kpara), 8);
            kpara /= 10;
        }
        OLED_Draw_Chars(x + 56, y, comma, 8);
        for (i = 1; i < 4; i++)
        {
            OLED_Draw_Chars(x + 88 - 8 * i, y, judgenum(npara), 8);
            npara /= 10;
        }
    }
    else if (para >= 1000)
    {
        for (i = 1; i < 4; i++)
        {
            OLED_Draw_Chars(x + 24 - 8 * i, y, judgenum(kpara), 8);
            kpara /= 10;
        }
        OLED_Draw_Chars(x + 24, y, comma, 8);
        for (i = 1; i < 4; i++)
        {
            OLED_Draw_Chars(x + 56 - 8 * i, y, judgenum(npara), 8);
            npara /= 10;
        }
        OLED_Draw_Chars(x + 56, y, symbol_dot, 8);
        for (i = 1; i < 4; i++)
        {
            OLED_Draw_Chars(x + 88 - 8 * i, y, judgenum(mpara), 8);
            mpara /= 10;
        }
    }
    else if (para >= 1)
    {
        for (i = 1; i < 4; i++)
        {
            OLED_Draw_Chars(x + 24 - 8 * i, y, judgenum(npara), 8);
            npara /= 10;
        }
        OLED_Draw_Chars(x + 24, y, symbol_dot, 8);
        for (i = 1; i < 4; i++)
        {
            OLED_Draw_Chars(x + 56 - 8 * i, y, judgenum(mpara), 8);
            mpara /= 10;
        }
        OLED_Draw_Chars(x + 56, y, comma, 8);
        for (i = 1; i < 4; i++)
        {
            OLED_Draw_Chars(x + 88 - 8 * i, y, judgenum(upara), 8);
            upara /= 10;
        }
    }
    else if (para < 1)
    {
        for (i = 1; i < 4; i++)
        {
            OLED_Draw_Chars(x + 24 - 8 * i, y, Number[0], 8);
        }
        OLED_Draw_Chars(x + 24, y, symbol_dot, 8);
        for (i = 1; i < 4; i++)
        {
            OLED_Draw_Chars(x + 56 - 8 * i, y, judgenum(mpara), 8);
            mpara /= 10;
        }
        OLED_Draw_Chars(x + 56, y, comma, 8);
        for (i = 1; i < 4; i++)
        {
            OLED_Draw_Chars(x + 88 - 8 * i, y, judgenum(upara), 8);
            upara /= 10;
        }
    }
}

void Display_String(unsigned char x, unsigned char y, unsigned char str[], int strlen)
{
    int i = 0;
    int j = 0;
    while (i < strlen)
    {
        if (x > 120)
        {
            x = 0;
            y += 2;
            if (y >= 8)
            {
                break;
            }
        }
        if (str[i] >= 48 && str[i] <= 57)
        {
            j = 0 + str[i] - 48;
            OLED_Draw_Chars(x, y, Number[j], 8);
        }
        else if (str[i] >= 65 && str[i] <= 90)
        {
            j = 0 + str[i] - 65;
            OLED_Draw_Chars(x, y, Alphabet[j], 8);
        }
        else if (str[i] >= 97 && str[i] <= 122)
        {
            j = 0 + str[i] - 71;
            OLED_Draw_Chars(x, y, Alphabet[j], 8);
        }
        else if (str[i] == 58)
        {
            OLED_Draw_Chars(x, y, colon, 8);
        }
        else if (str[i] == 46)
        {
            OLED_Draw_Chars(x, y, symbol_dot, 8);
        }
        else
        {
            OLED_Draw_Chars(x, y, space, 8);
        }
        x += 8;
        i++;
    }
}

const unsigned char *judgenum(unsigned int num)
{
    return Number[(num % 10)];
}
